## arch/arm/configs/msm8960_defconfig
```kconfig
CONFIG_IP_MULTICAST=y
CONFIG_EXPERIMENTAL=y
CONFIG_MSM_DCVS=y
CONFIG_SYSVIPC=y
CONFIG_IKCONFIG=y
CONFIG_IKCONFIG_PROC=y
CONFIG_CGROUPS=y
CONFIG_CGROUP_DEBUG=y
CONFIG_CGROUP_FREEZER=y
CONFIG_CGROUP_CPUACCT=y
CONFIG_RESOURCE_COUNTERS=y
CONFIG_CGROUP_SCHED=y
CONFIG_FAIR_GROUP_SCHED=y
CONFIG_RT_GROUP_SCHED=y
CONFIG_NAMESPACES=y
# CONFIG_UTS_NS is not set
# CONFIG_IPC_NS is not set
# CONFIG_USER_NS is not set
# CONFIG_PID_NS is not set
# CONFIG_NET_NS is not set
CONFIG_BLK_DEV_INITRD=y
CONFIG_RD_BZIP2=y
CONFIG_RD_LZMA=y
CONFIG_CC_OPTIMIZE_FOR_SIZE=y
CONFIG_PANIC_TIMEOUT=5
CONFIG_KALLSYMS_ALL=y
CONFIG_ASHMEM=y
CONFIG_EMBEDDED=y
CONFIG_PROFILING=y
CONFIG_OPROFILE=y
CONFIG_KPROBES=y
CONFIG_MODULES=y
CONFIG_MODULE_UNLOAD=y
CONFIG_MODULE_FORCE_UNLOAD=y
# CONFIG_MODVERSIONS is not set
CONFIG_ARCH_MSM=y
CONFIG_ARCH_MSM8960=y
CONFIG_ARCH_MSM8930=y
CONFIG_ARCH_APQ8064=y
CONFIG_MSM_KRAIT_TBB_ABORT_HANDLER=y
CONFIG_MACH_MSM8960_SIM=y
CONFIG_MACH_MSM8960_RUMI3=y
CONFIG_MACH_MSM8960_CDP=y
CONFIG_MACH_MSM8960_MTP=y
CONFIG_MACH_MSM8960_FLUID=y
CONFIG_MACH_MSM8960_LIQUID=y
CONFIG_MACH_MSM8930_CDP=y
CONFIG_MACH_MSM8930_MTP=y
CONFIG_MACH_MSM8930_FLUID=y
CONFIG_MACH_MSM8627_CDP=y
CONFIG_MACH_MSM8627_MTP=y
CONFIG_MACH_APQ8064_SIM=y
CONFIG_MACH_APQ8064_RUMI3=y
# CONFIG_MSM_STACKED_MEMORY is not set
CONFIG_KERNEL_PMEM_EBI_REGION=y
# CONFIG_MSM_FIQ_SUPPORT is not set
# CONFIG_MSM_PROC_COMM is not set
CONFIG_MSM_SMD=y
CONFIG_MSM_SMD_PKG4=y
CONFIG_MSM_BAM_DMUX=y
# CONFIG_MSM_DSPS is not set
CONFIG_MSM_IPC_ROUTER=y
CONFIG_MSM_IPC_ROUTER_SMD_XPRT=y
# CONFIG_MSM_HW3D is not set
CONFIG_MSM_PIL_QDSP6V4=y
CONFIG_MSM_PIL_RIVA=y
CONFIG_MSM_PIL_TZAPPS=y
CONFIG_MSM_PIL_VIDC=y
CONFIG_MSM_SUBSYSTEM_RESTART=y
CONFIG_MSM_MODEM_8960=y
CONFIG_MSM_LPASS_8960=y
CONFIG_MSM_WCNSS_SSR_8960=y
CONFIG_MSM_RPM_LOG=y
CONFIG_MSM_BUS_SCALING=y
CONFIG_MSM_BUS_RPM_MULTI_TIER_ENABLED=y
CONFIG_MSM_WATCHDOG=y
CONFIG_MSM_DLOAD_MODE=y
CONFIG_MSM_QDSS=y
CONFIG_MSM_QDSS_ETM_DEFAULT_ENABLE=y
CONFIG_CLOCK_MAP=y
CONFIG_MSM_SLEEP_STATS=y
CONFIG_MSM_AUDIO_QDSP6=y
CONFIG_MSM_RTB=y
CONFIG_MSM_RTB_SEPARATE_CPUS=y
CONFIG_MSM_CACHE_ERP=y
CONFIG_MSM_L1_ERR_PANIC=n
CONFIG_MSM_L1_ERR_LOG=y
CONFIG_MSM_L2_ERP_1BIT_PANIC=n
CONFIG_MSM_L2_ERP_2BIT_PANIC=n
CONFIG_MSM_CACHE_DUMP=y
CONFIG_MSM_CACHE_DUMP_ON_PANIC=y
CONFIG_STRICT_MEMORY_RWX=y

#
# NCMC Product Option
#
# CONFIG_FEATURE_NCMC_GG1 is not set
# CONFIG_FEATURE_NCMC_GG2 is not set
# CONFIG_FEATURE_NCMC_TRIGGER is not set
# CONFIG_FEATURE_NCMC_HAMMER is not set
# CONFIG_FEATURE_NCMC_TURTLE is not set
# CONFIG_FEATURE_NCMC_PEACOCK is not set
# CONFIG_FEATURE_NCMC_GINGA is not set
# CONFIG_FEATURE_NCMC_SUNSHINE is not set
# CONFIG_FEATURE_NCMC_GEKKO is not set
# CONFIG_FEATURE_NCMC_SNIPER is not set
# CONFIG_FEATURE_NCMC_ALEX is not set
# CONFIG_FEATURE_NCMC_ELEGANT_SLIM is not set
CONFIG_FEATURE_NCMC_D121F=y
# CONFIG_FEATURE_NCMC_D121M is not set
# CONFIG_FEATURE_NCMC_G121S is not set
CONFIG_FEATURE_NCMC_RUBY=y

# CONFIG_OEM_NCMC_HMR is not set
# CONFIG_OEM_NCMC_ELEGANT_SLIM is not set
# CONFIG_OEM_NCMC_TTL is not set
CONFIG_FEATURE_NCMC_NEC=y
# CONFIG_FEATURE_NCMC_CASIO is not set
# CONFIG_FEATURE_NCMC_HITACHI is not set
CONFIG_FEATURE_NCMC_DOCOMO=y
# CONFIG_FEATURE_NCMC_KDDI is not set
# CONFIG_FEATURE_NCMC_SOFTBANK is not set
# CONFIG_FEATURE_NCMC_VERIZON is not set
# CONFIG_FEATURE_NCMC_ONLY_FOR_PRODUCTION_PROCESS_8960 is not set
# CONFIG_FEATURE_NCMC_Q89_BRB is not set

#
# NCMC Hardware Specification Options
#
CONFIG_NCMC_TRIGGER=y
# CONFIG_NCMC_TRIGGER_BRB is not set

CONFIG_FEATURE_NCMC_BSP=y
CONFIG_FEATURE_NCMC_LCD=y
CONFIG_FEATURE_NCMC_SDCARD=y
CONFIG_FEATURE_NCMC_UIM=y
CONFIG_FEATURE_NCMC_CAMERA=y
CONFIG_FEATURE_NCMC_AUDIO=y
CONFIG_FEATURE_NCMC_POWER=y
CONFIG_FEATURE_NCMC_LED=y
CONFIG_FEATURE_NCMC_IR=y
CONFIG_FEATURE_NCMC_KEY=y
CONFIG_FEATURE_NCMC_VIB=y
CONFIG_FEATURE_NCMC_I2C=y
CONFIG_FEATURE_NCMC_USB=y
CONFIG_FEATURE_NCMC_6AXIS_SENSOR=y
CONFIG_FEATURE_NCMC_PROX_SENSOR=y
CONFIG_FEATURE_NCMC_AMBLIGHT_SENSOR=y
CONFIG_FEATURE_NCMC_TEMP_SENSOR=y
CONFIG_FEATURE_NCMC_WLAN=y
CONFIG_FEATURE_NCMC_BT=y
CONFIG_FEATURE_NCMC_HEAT=y
CONFIG_FEATURE_NCMC_HDMI=y
CONFIG_FEATURE_NCMC_GPS=y
CONFIG_FEATURE_NCMC_CDMA=y
CONFIG_FEATURE_NCMC_GSM=y
CONFIG_FEATURE_NCMC_DIAG=y
CONFIG_FEATURE_NCMC_DIAG_PW=y
CONFIG_FEATURE_NCMC_TOUCHPANEL=y

#
# NCMC typical function option
#
# CONFIG_FEATURE_NCMC_CPRM is not set
# CONFIG_FEATURE_NCMC_FELICA is not set
CONFIG_FEATURE_NCMC_REMOTE_LOCK=y
CONFIG_FEATURE_NCMC_SYS_UPDATE=y
CONFIG_FEATURE_NCMC_CLEAR_PASS=y
CONFIG_FEATURE_NCMC_CAREERMAIL=y
CONFIG_FEATURE_NCMC_MMS=y
CONFIG_FEATURE_NCMC_COMFORT_TONE=y
CONFIG_FEATURE_NCMC_IPOVERUSB=y
CONFIG_FEATURE_NCMC_MAIL_IM_EXPORT=y
CONFIG_FEATURE_NCMC_SMS_IM_EXPORT=y
CONFIG_FEATURE_NCMC_FOTA=y
CONFIG_FEATURE_NCMC_DRM_WM=y
CONFIG_FEATURE_NCMC_DRM_PR=y
CONFIG_FEATURE_NCMC_DRM_OMA=y
CONFIG_FEATURE_NCMC_DTV=y
CONFIG_FEATURE_NCMC_WIFISETTING_APMODE=y
CONFIG_FEATURE_NCMC_WIFISETTING_RAKURAKU=y
CONFIG_FEATURE_NCMC_WIFISETTING_PRIORITY=y
CONFIG_FEATURE_NCMC_WIFISETTING_AIRPLANE=y
CONFIG_FEATURE_NCMC_CAMERA_CONTINUOUS_AF=y
CONFIG_FEATURE_NCMC_CAMERA_FACE_DETECT=y
CONFIG_FEATURE_NCMC_CAM_SHAKE_RESISTANT=y
CONFIG_FEATURE_NCMC_CAM_QUICK_SHOT=y
CONFIG_FEATURE_NCMC_CAM_AUTO_SCENE_PICT=y
CONFIG_FEATURE_NCMC_CAM_SPEED_MOVIE=y
CONFIG_FEATURE_NCMC_CAM_SETTING=y
CONFIG_FEATURE_NCMC_CAM_SELF_TIMER=y
CONFIG_FEATURE_NCMC_CAM_CONTINUOUS_SHOOT=y
CONFIG_FEATURE_NCMC_CAM_MOBILE_LIGHT=y
CONFIG_FEATURE_NCMC_CAM_LIGHT_PREVENT_PEEPING=y
CONFIG_FEATURE_NCMC_CAM_EXIF=y
# CONFIG_FEATURE_NCMC_IRDA is not set
CONFIG_FEATURE_NCMC_SE13_LIST=y
CONFIG_FEATURE_NCMC_OPERATOR_NAME_DOCOMO=y
CONFIG_FEATURE_NCMC_CAM_SOUND_PREVENT_PEEPING=y
CONFIG_FEATURE_NCMC_EMERGENCY_JPN=y
CONFIG_FEATURE_NCMC_FAST_DORMANCY=y
CONFIG_FEATURE_NCMC_PWR_ON_FEEDBACK=y
CONFIG_FEATURE_NCMC_SPMODE=y
CONFIG_FEATURE_NCMC_BATTERY_IM=y

#
# NCMC Common defines selection.
#
# CONFIG_NX9320 is not set
# CONFIG_OEM_CH_GG1 is not set
CONFIG_OEM_CH_NORMAL_RELEASE=y
# CONFIG_CHMC_EARLY_TEMPORARY is not set
# CONFIG_CHMC_EARLY_TEMPORALY_DISP is not set
# CONFIG_CHMC_EARLY_TEMPORARY_USB is not set
CONFIG_NCMC_USB=y

CONFIG_NO_HZ=y
CONFIG_HIGH_RES_TIMERS=y
CONFIG_SMP=y
# CONFIG_SMP_ON_UP is not set
CONFIG_PREEMPT=y
CONFIG_AEABI=y
CONFIG_HIGHMEM=y
CONFIG_VMALLOC_RESERVE=0x19000000
CONFIG_CC_STACKPROTECTOR=y
CONFIG_CP_ACCESS=y
CONFIG_CPU_FREQ=y
CONFIG_CPU_FREQ_GOV_POWERSAVE=y
CONFIG_CPU_FREQ_GOV_USERSPACE=y
CONFIG_CPU_FREQ_GOV_ONDEMAND=y
CONFIG_CPU_IDLE=y
CONFIG_VFP=y
CONFIG_NEON=y
# CONFIG_CORE_DUMP_DEFAULT_ELF_HEADERS is not set
CONFIG_WAKELOCK=y
CONFIG_PM_RUNTIME=y
CONFIG_NET=y
CONFIG_PACKET=y
CONFIG_UNIX=y
CONFIG_INET=y
CONFIG_IP_ADVANCED_ROUTER=y
CONFIG_IP_MULTIPLE_TABLES=y
CONFIG_IP_ROUTE_VERBOSE=y
CONFIG_IP_PNP=y
CONFIG_IP_PNP_DHCP=y
# CONFIG_INET_LRO is not set
CONFIG_INET_XFRM_MODE_TRANSPORT=y
CONFIG_INET_XFRM_MODE_TUNNEL=y
CONFIG_INET_XFRM_MODE_BEET=y
CONFIG_INET_XFRM_TUNNEL=y
CONFIG_INET_AH=y
CONFIG_INET_ESP=y
CONFIG_NET_KEY=y
CONFIG_CRYPTO_NULL=y
CONFIG_IPV6=y
CONFIG_IPV6_PRIVACY=y
CONFIG_IPV6_ROUTER_PREF=y
CONFIG_IPV6_ROUTE_INFO=y
CONFIG_IPV6_OPTIMISTIC_DAD=y
CONFIG_INET6_AH=y
CONFIG_INET6_ESP=y
CONFIG_INET6_IPCOMP=y
CONFIG_IPV6_MIP6=y
CONFIG_IPV6_MULTIPLE_TABLES=y
CONFIG_IPV6_SUBTREES=y
CONFIG_NETFILTER=y
CONFIG_NETFILTER_NETLINK_LOG=y
CONFIG_NF_CONNTRACK=y
CONFIG_NF_CONNTRACK_EVENTS=y
CONFIG_NF_CT_PROTO_DCCP=y
CONFIG_NF_CT_PROTO_SCTP=y
CONFIG_NF_CT_PROTO_UDPLITE=y
CONFIG_NF_CONNTRACK_AMANDA=y
CONFIG_NF_CONNTRACK_FTP=y
CONFIG_NF_CONNTRACK_H323=y
CONFIG_NF_CONNTRACK_IRC=y
CONFIG_NF_CONNTRACK_NETBIOS_NS=y
CONFIG_NF_CONNTRACK_PPTP=y
CONFIG_NF_CONNTRACK_SANE=y
CONFIG_NF_CONNTRACK_SIP=y
CONFIG_NF_CONNTRACK_TFTP=y
CONFIG_NF_CT_NETLINK=y
CONFIG_NETFILTER_TPROXY=y
CONFIG_NETFILTER_XT_TARGET_CLASSIFY=y
CONFIG_NETFILTER_XT_TARGET_CONNMARK=y
CONFIG_NETFILTER_XT_TARGET_MARK=y
CONFIG_NETFILTER_XT_TARGET_NFQUEUE=y
CONFIG_NETFILTER_XT_MATCH_COMMENT=y
CONFIG_NETFILTER_XT_MATCH_CONNLIMIT=y
CONFIG_NETFILTER_XT_MATCH_CONNMARK=y
CONFIG_NETFILTER_XT_MATCH_CONNTRACK=y
CONFIG_NETFILTER_XT_MATCH_HASHLIMIT=y
CONFIG_NETFILTER_XT_MATCH_HELPER=y
CONFIG_NETFILTER_XT_MATCH_IPRANGE=y
CONFIG_NETFILTER_XT_MATCH_LENGTH=y
CONFIG_NETFILTER_XT_MATCH_LIMIT=y
CONFIG_NETFILTER_XT_MATCH_MAC=y
CONFIG_NETFILTER_XT_MATCH_MARK=y
CONFIG_NETFILTER_XT_MATCH_MULTIPORT=y
CONFIG_NETFILTER_XT_MATCH_POLICY=y
CONFIG_NETFILTER_XT_MATCH_PKTTYPE=y
CONFIG_NETFILTER_XT_MATCH_QTAGUID=y
CONFIG_NETFILTER_XT_MATCH_QUOTA=y
CONFIG_NETFILTER_XT_MATCH_QUOTA2=y
CONFIG_NETFILTER_XT_MATCH_QUOTA2_LOG=y
CONFIG_NETFILTER_XT_MATCH_SOCKET=y
CONFIG_NETFILTER_XT_MATCH_STATE=y
CONFIG_NETFILTER_XT_MATCH_STATISTIC=y
CONFIG_NETFILTER_XT_MATCH_STRING=y
CONFIG_NETFILTER_XT_MATCH_TIME=y
CONFIG_NETFILTER_XT_MATCH_U32=y
CONFIG_NF_CONNTRACK_IPV4=y
CONFIG_IP_NF_IPTABLES=y
CONFIG_IP_NF_MATCH_AH=y
CONFIG_IP_NF_MATCH_ECN=y
CONFIG_IP_NF_MATCH_TTL=y
CONFIG_IP_NF_FILTER=y
CONFIG_IP_NF_TARGET_REJECT=y
CONFIG_IP_NF_TARGET_LOG=y
CONFIG_NF_NAT=y
CONFIG_IP_NF_TARGET_MASQUERADE=y
CONFIG_IP_NF_TARGET_NETMAP=y
CONFIG_IP_NF_TARGET_REDIRECT=y
CONFIG_IP_NF_MANGLE=y
CONFIG_IP_NF_ARPTABLES=y
CONFIG_IP_NF_ARPFILTER=y
CONFIG_IP_NF_ARP_MANGLE=y
CONFIG_NF_CONNTRACK_IPV6=y
CONFIG_IP6_NF_IPTABLES=y
CONFIG_IP6_NF_FILTER=y
CONFIG_IP6_NF_TARGET_REJECT=y
CONFIG_IP6_NF_MANGLE=y
CONFIG_NET_SCHED=y
CONFIG_NET_SCH_HTB=y
CONFIG_NET_SCH_PRIO=y
CONFIG_NET_CLS_FW=y
CONFIG_NET_CLS_U32=y
CONFIG_CLS_U32_MARK=y
CONFIG_NET_CLS_FLOW=y
CONFIG_NET_EMATCH=y
CONFIG_NET_EMATCH_CMP=y
CONFIG_NET_EMATCH_NBYTE=y
CONFIG_NET_EMATCH_U32=y
CONFIG_NET_EMATCH_META=y
CONFIG_NET_EMATCH_TEXT=y
CONFIG_NET_CLS_ACT=y
CONFIG_BT=y
CONFIG_BT_L2CAP=y
CONFIG_BT_SCO=y
CONFIG_BT_RFCOMM=y
CONFIG_BT_RFCOMM_TTY=y
CONFIG_BT_BNEP=y
CONFIG_BT_BNEP_MC_FILTER=y
CONFIG_BT_BNEP_PROTO_FILTER=y
CONFIG_BT_HIDP=y
CONFIG_BT_HCISMD=y
CONFIG_MSM_BT_POWER=y
CONFIG_CFG80211=y
# CONFIG_CFG80211_WEXT is not set
CONFIG_RFKILL=y
CONFIG_GENLOCK=y
CONFIG_GENLOCK_MISCDEVICE=y
CONFIG_BLK_DEV_LOOP=y
CONFIG_BLK_DEV_RAM=y
CONFIG_MISC_DEVICES=y
CONFIG_PMIC8XXX_VIBRATOR=y
CONFIG_QSEECOM=y
CONFIG_SCSI=y
CONFIG_SCSI_TGT=y
CONFIG_BLK_DEV_SD=y
CONFIG_CHR_DEV_SG=y
CONFIG_CHR_DEV_SCH=y
CONFIG_SCSI_MULTI_LUN=y
CONFIG_SCSI_CONSTANTS=y
CONFIG_SCSI_LOGGING=y
CONFIG_SCSI_SCAN_ASYNC=y
CONFIG_MD=y
CONFIG_BLK_DEV_DM=y
CONFIG_DM_CRYPT=y
CONFIG_NETDEVICES=y
CONFIG_DUMMY=y
CONFIG_TUN=y
CONFIG_NET_ETHERNET=y
CONFIG_SMC91X=y
CONFIG_SMC911X=y
CONFIG_SMSC911X=y
#CONFIG_KS8851 is not set
# CONFIG_NETDEV_1000 is not set
# CONFIG_NETDEV_10000 is not set
CONFIG_WCNSS_CORE=y
CONFIG_USB_USBNET=y
CONFIG_MSM_RMNET_USB=y
CONFIG_PPP=y
CONFIG_PPP_MULTILINK=y
CONFIG_PPP_FILTER=y
CONFIG_PPP_ASYNC=y
CONFIG_PPP_SYNC_TTY=y
CONFIG_PPP_DEFLATE=y
CONFIG_PPP_BSDCOMP=y
CONFIG_PPP_MPPE=y
CONFIG_PPPOE=y
CONFIG_PPPOL2TP=y
CONFIG_PPPOLAC=y
CONFIG_PPPOPNS=y
CONFIG_SLIP=y
CONFIG_SLIP_COMPRESSED=y
CONFIG_SLIP_MODE_SLIP6=y
# CONFIG_MSM_RMNET is not set
CONFIG_MSM_RMNET_BAM=y
CONFIG_INPUT_EVDEV=y
CONFIG_INPUT_EVBUG=m
CONFIG_KEYBOARD_PMIC8XXX=y
CONFIG_INPUT_JOYSTICK=y
CONFIG_JOYSTICK_XPAD=y
CONFIG_INPUT_TOUCHSCREEN=y
# CONFIG_TOUCHSCREEN_ATMEL_MXT is not set
# CONFIG_TOUCHSCREEN_CYTTSP_I2C is not set
# CONFIG_TOUCHSCREEN_SYNAPTICS_NCM is not set
CONFIG_TOUCHSCREEN_eKTF2136=y
CONFIG_INPUT_MISC=y
# CONFIG_INPUT_ANALOGDEVICE_ADUX1001_NCM is not set
# CONFIG_INPUT_TI_DRV2665_NCM is not set
CONFIG_INPUT_UINPUT=y
CONFIG_INPUT_PMIC8XXX_PWRKEY=y
CONFIG_SERIAL_MSM=y
CONFIG_SERIAL_MSM_HS=y
# CONFIG_SERIAL_MSM_CLOCK_CONTROL is not set
CONFIG_SERIAL_MSM_HSL=y
# CONFIG_SERIAL_MSM_HSL_CONSOLE is not set
CONFIG_DIAG_CHAR=y
CONFIG_DIAG_W=y
CONFIG_KEY_DIAG_W=y
CONFIG_TOUCHPANEL_DIAG_W=y
CONFIG_HW_RANDOM=y
CONFIG_HW_RANDOM_MSM=y
CONFIG_I2C=y
CONFIG_I2C_CHARDEV=y
# CONFIG_I2C_MSM is not set
CONFIG_I2C_QUP=y
CONFIG_SPI=y
CONFIG_SPI_QUP=y
CONFIG_SPI_SPIDEV=m
CONFIG_SLIMBUS_MSM_CTRL=y
CONFIG_DEBUG_GPIO=y
CONFIG_GPIO_SYSFS=y
CONFIG_GPIO_SX150X=y
CONFIG_POWER_SUPPLY=y
# Miscellaneous I2C Chip support
# CONFIG_SENSORS_PCA963X is not set
# CONFIG_SENSORS_MT9T013 is not set
# CONFIG_SENSORS_3AXIS is not set
# CONFIG_SENSORS_GP2AP012A00F is not set
# CONFIG_SENSORS_AKM8977 is not set
#CONFIG_SENSORS_L3G4200D is not set
CONFIG_SENSORS_APDS990X=y
CONFIG_INPUT_YAS_ACCELEROMETER=y
CONFIG_INPUT_YAS_MAGNETOMETER=y
CONFIG_INPUT_YAS_ORIENTATION=y
# CONFIG_BATTERY_MSM is not set
CONFIG_PM8921_CHARGER=y
CONFIG_PM8921_BMS=y
CONFIG_SENSORS_PM8XXX_ADC=y
CONFIG_THERMAL=y
CONFIG_THERMAL_TSENS8960=y
CONFIG_THERMAL_PM8XXX=y
CONFIG_THERMAL_MONITOR=y
CONFIG_MFD_PM8921_CORE=y
CONFIG_MFD_PM8038_CORE=y
CONFIG_MFD_PM8XXX_BATT_ALARM=y
CONFIG_WCD9310_CODEC=y
CONFIG_SND_SOC_WCD9310=y
CONFIG_FEATURE_NCMC_AUDIO_YDA160=y
CONFIG_AUDIENCE_ES310=y
CONFIG_REGULATOR_PM8XXX=y
CONFIG_REGULATOR_GPIO=y
CONFIG_MEDIA_SUPPORT=y
CONFIG_VIDEO_DEV=y
# CONFIG_MEDIA_TUNER_CUSTOMISE is not set
CONFIG_VIDEO_HELPER_CHIPS_AUTO=y
CONFIG_USB_VIDEO_CLASS=y
CONFIG_MSM_CAMERA_V4L2=y
# CONFIG_IMX111 is not set
# CONFIG_IMX111_ACT is not set
# CONFIG_MT9M113 is not set
CONFIG_S5K4ECGX=y
CONFIG_MT9V113=y
CONFIG_MSM_CAMERA_FLASH=y
CONFIG_MSM_CAMERA_SENSOR=y
CONFIG_MSM_ACTUATOR=y
# CONFIG_IMX074 is not set
# CONFIG_IMX074_ACT is not set
# CONFIG_OV2720 is not set
# CONFIG_S5K3L1YX is not set
CONFIG_MSM_GEMINI=y
CONFIG_RADIO_IRIS=y
CONFIG_RADIO_IRIS_TRANSPORT=m
CONFIG_ION=y
CONFIG_ION_MSM=y
CONFIG_MSM_KGSL=y
CONFIG_KGSL_PER_PROCESS_PAGE_TABLE=y
CONFIG_MSM_KGSL_PAGE_TABLE_COUNT=24
CONFIG_FB=y
CONFIG_FB_VIRTUAL=y
CONFIG_FB_MSM=y
# CONFIG_FB_MSM_BACKLIGHT is not set
CONFIG_FB_MSM_TRIPLE_BUFFER=y
CONFIG_FB_MSM_MDP40=y
CONFIG_FB_MSM_OVERLAY=y
CONFIG_GG3_LCD_ROTATION=y
CONFIG_FB_MSM_OVERLAY0_WRITEBACK=y
CONFIG_FB_MSM_OVERLAY1_WRITEBACK=y
CONFIG_FB_MSM_WRITEBACK_MSM_PANEL=y
CONFIG_FB_MSM_MIPI_PANEL_DETECT=y
CONFIG_FB_MSM_MIPI_DSI_NT35560=y
# CONFIG_FB_MSM_MIPI_NT35560_VIDEO_VGA_PT is not set
# CONFIG_FB_MSM_MIPI_NT35560_VIDEO_VGA_PT_PANEL is not set
CONFIG_FB_MSM_MIPI_NT35560_CMD_VGA_PT=y
CONFIG_FB_MSM_MIPI_NT35560_CMD_VGA_PT_PANEL=y
CONFIG_FB_MSM_HDMI_MSM_PANEL=y
# ADD-S S_DRV_LCD
# CONFIG_FB_MSM_MIPI_DSI is not set
# CONFIG_FB_MSM_MIPI_DSI_RENESAS_HD is not set
# CONFIG_FB_MSM_MIPI_TOSHIBA_VIDEO_HD_PT is not set
# CONFIG_FB_MSM_MIPI_NCMC_VIDEO_HD_PT_PANEL_DB is not set
# ADD-E S_DRV_LCD
CONFIG_BACKLIGHT_LCD_SUPPORT=y
CONFIG_BACKLIGHT_CLASS_DEVICE=y
CONFIG_SOUND=y
CONFIG_SND=y
CONFIG_SND_DYNAMIC_MINORS=y
# CONFIG_SND_ARM is not set
# CONFIG_SND_SPI is not set
CONFIG_SND_USB_AUDIO=y
CONFIG_SND_SOC=y
CONFIG_SND_SOC_MSM8960=y
CONFIG_HID_APPLE=y
CONFIG_HID_MAGICMOUSE=y
CONFIG_HID_MICROSOFT=y
CONFIG_USB=y
CONFIG_USB_ANNOUNCE_NEW_DEVICES=y
CONFIG_USB_SUSPEND=y
CONFIG_USB_EHCI_HCD=y
CONFIG_USB_EHCI_EHSET=y
CONFIG_USB_EHCI_MSM=y
CONFIG_USB_EHCI_MSM_HSIC=y
CONFIG_USB_ACM=y
CONFIG_USB_STORAGE=y
CONFIG_USB_STORAGE_DEBUG=y
CONFIG_USB_STORAGE_DATAFAB=y
CONFIG_USB_STORAGE_FREECOM=y
CONFIG_USB_STORAGE_ISD200=y
CONFIG_USB_STORAGE_USBAT=y
CONFIG_USB_STORAGE_SDDR09=y
CONFIG_USB_STORAGE_SDDR55=y
CONFIG_USB_STORAGE_JUMPSHOT=y
CONFIG_USB_STORAGE_ALAUDA=y
CONFIG_USB_STORAGE_ONETOUCH=y
CONFIG_USB_STORAGE_KARMA=y
CONFIG_USB_STORAGE_CYPRESS_ATACB=y
CONFIG_USB_EHSET_TEST_FIXTURE=y
CONFIG_USB_QCOM_MDM_BRIDGE=y
CONFIG_USB_GADGET=y
CONFIG_USB_GADGET_DEBUG_FILES=y
CONFIG_USB_GADGET_CI13XXX_MSM=y
CONFIG_USB_G_ANDROID=y
CONFIG_USB_ANDROID_RMNET_CTRL_SMD=y
CONFIG_MMC=y
# CONFIG_MMC_PERF_PROFILING is not set
CONFIG_MMC_UNSAFE_RESUME=y
CONFIG_MMC_PARANOID_SD_INIT=y
CONFIG_MMC_BLOCK_MINORS=32
CONFIG_MMC_TEST=m
CONFIG_MMC_MSM=y
CONFIG_MMC_MSM_CARD_HW_DETECTION=y
CONFIG_MMC_MSM_SDC1_8_BIT_SUPPORT=y
# CONFIG_MMC_MSM_SDC2_SUPPORT is not set
CONFIG_MMC_MSM_SDC3_SUPPORT=y
CONFIG_MMC_MSM_SDC3_WP_SUPPORT=y
CONFIG_MMC_MSM_SPS_SUPPORT=y
CONFIG_LEDS_PM8XXX=y
CONFIG_LEDS_ADP8861=y
CONFIG_LEDS_LM3537=y
CONFIG_LEDS_DIAG_WRAPPER=y
CONFIG_LEDS_TRIGGERS=y
CONFIG_LEDS_TRIGGER_SLEEP=y
CONFIG_LEDS_TRIGGER_CXO_OFF=y
CONFIG_LEDS_ADP8861_ILLUMI=y
CONFIG_SWITCH=y
CONFIG_RTC_CLASS=y
# CONFIG_RTC_DRV_MSM is not set
CONFIG_RTC_DRV_PM8XXX=y
CONFIG_STAGING=y
CONFIG_ANDROID=y
CONFIG_ANDROID_BINDER_IPC=y
CONFIG_ANDROID_LOGGER=y
CONFIG_ANDROID_RAM_CONSOLE=y
CONFIG_ANDROID_RAM_CONSOLE_ERROR_CORRECTION=y
CONFIG_ANDROID_TIMED_GPIO=y
CONFIG_ANDROID_LOW_MEMORY_KILLER=y
CONFIG_MSM_SSBI=y
CONFIG_SPS=y
CONFIG_SPS_SUPPORT_BAMDMA=y
CONFIG_EXT2_FS=y
CONFIG_EXT2_FS_XATTR=y
CONFIG_EXT3_FS=y
# CONFIG_EXT3_DEFAULTS_TO_ORDERED is not set
CONFIG_EXT4_FS=y
CONFIG_FUSE_FS=y
CONFIG_VFAT_FS=y
CONFIG_TMPFS=y
CONFIG_NFS_FS=y
CONFIG_NFS_V3=y
CONFIG_NFS_V3_ACL=y
CONFIG_NFS_V4=y
CONFIG_CIFS=y
CONFIG_PARTITION_ADVANCED=y
CONFIG_EFI_PARTITION=y
CONFIG_NLS_CODEPAGE_437=y
CONFIG_NLS_ASCII=y
CONFIG_NLS_ISO8859_1=y
CONFIG_PRINTK_TIME=y
CONFIG_MAGIC_SYSRQ=y
CONFIG_DEBUG_KERNEL=y
# CONFIG_SCHED_DEBUG is not set
CONFIG_TIMER_STATS=y
CONFIG_UID_STAT=y
CONFIG_DEBUG_KMEMLEAK=y
CONFIG_DEBUG_KMEMLEAK_DEFAULT_OFF=y
# CONFIG_DEBUG_PREEMPT is not set
CONFIG_DEBUG_STACK_USAGE=y
CONFIG_DEBUG_INFO=y
CONFIG_DEBUG_MEMORY_INIT=y
CONFIG_FAULT_INJECTION=y
CONFIG_FAILSLAB=y
CONFIG_FAIL_PAGE_ALLOC=y
CONFIG_FAULT_INJECTION_DEBUG_FS=y
CONFIG_FAULT_INJECTION_STACKTRACE_FILTER=y
CONFIG_DYNAMIC_DEBUG=y
CONFIG_DEBUG_USER=y
CONFIG_PID_IN_CONTEXTIDR=y
CONFIG_CRYPTO_SHA256=y
CONFIG_CRYPTO_TWOFISH=y
CONFIG_CRYPTO_DEV_QCRYPTO=m
CONFIG_CRYPTO_DEV_QCE=m
CONFIG_CRYPTO_DEV_QCEDEV=m
CONFIG_CRC_CCITT=y
CONFIG_TSIF=y
CONFIG_FEATURE_NCMC_NFC=y
# CONFIG_MSM_SECURE_IO is not set
# CONFIG_MSM_TZ_LOG is not set
# CONFIG_MSM_SECURE_IO is not set
# CONFIG_MSM_TZ_LOG is not set
# CONFIG_MSM_SECURE_IO is not set
# CONFIG_MSM_TZ_LOG is not set
# CONFIG_MSM_SECURE_IO is not set
# CONFIG_MSM_TZ_LOG is not set
# CONFIG_MSM_SECURE_IO is not set
# CONFIG_MSM_TZ_LOG is not set
# CONFIG_MSM_SECURE_IO is not set
# CONFIG_MSM_TZ_LOG is not set
# CONFIG_MSM_SECURE_IO is not set
# CONFIG_MSM_TZ_LOG is not set
# CONFIG_MSM_SECURE_IO is not set
# CONFIG_MSM_TZ_LOG is not set
# CONFIG_MSM_SECURE_IO is not set
# CONFIG_MSM_TZ_LOG is not set
# CONFIG_MSM_SECURE_IO is not set
# CONFIG_MSM_TZ_LOG is not set
# CONFIG_MSM_SECURE_IO is not set
# CONFIG_MSM_TZ_LOG is not set
# CONFIG_MSM_SECURE_IO is not set
# CONFIG_MSM_TZ_LOG is not set
```
